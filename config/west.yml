## config/west.yml
```yaml
manifest:
  remotes:
    - name: zmkfirmware
      url-base: https://github.com/zmkfirmware
    - name: inorichi
      url-base: https://github.com/inorichi
    - name: keyfreaks
      url-base: https://github.com/kay-yokoyama
    - name: qtrnmr
      url-base: https://github.com/qtrnmr
    - name: cormoran
      url-base: https://github.com/cormoran
    - name: caksoylar
      url-base: https://github.com/caksoylar
  projects:
    - name: zmk
      remote: cormoran
      revision: main+custom-studio-protocol
      import: app/west.yml
    - name: zmk-feature-custom-settings
      remote: cormoran
      revision: main
    - name: zmk-feature-runtime-macro
      remote: cormoran
      revision: main
    - name: zmk-feature-runtime-combo
      remote: cormoran
      revision: main
    - name: zmk-module-runtime-input-processor
      remote: cormoran
      revision: main
    - name: zmk-rgbled-widget
      remote: caksoylar
      revision: e6b467792a1dabef8cfa5c9fd26bfefc9c16662b
  self:
    path: config
```

## modules/pmw3610/Kconfig
```kconfig
# Sensor data simulator
#
# Copyright (c) 2019 Nordic Semiconductor
#
# SPDX-License-Identifier: LicenseRef-Nordic-5-Clause
#

menuconfig LINEA40_PMW3610
    bool "LINEA40_PMW3610 mouse optical sensor"
  select SPI
    help
      Enable LINEA40_PMW3610 mouse optical sensor.

if LINEA40_PMW3610

config LINEA40_PMW3610_SMART_ALGORITHM
  bool "Enable an algorithm of LINEA40_PMW3610 to enhance surface coverage"
  default y
  help
    Enable the integration of the smart algorithm as the datasheet implementation.
    The algorithm is used to extend the tracking acrocss a wider range of surfaces
    such as graniles and tiles.

config LINEA40_PMW3610_CPI
    int "LINEA40_PMW3610's default CPI"
    default 800
    range 200 3200
    help
      Default CPI value, with 200 step

config LINEA40_PMW3610_CPI_DIVIDOR
    int "LINEA40_PMW3610's default CPI dividor"
    default 1
    range 1 100
    help
      Default CPI dividor value.

config LINEA40_PMW3610_SNIPE_CPI
    int "LINEA40_PMW3610's CPI in snipe mode"
    default 200
    range 200 3200
    help
      Snipe CPI value, with 200 step

config LINEA40_PMW3610_SNIPE_CPI_DIVIDOR
    int "LINEA40_PMW3610's CPI dividor in snipe mode"
    default 1
    range 1 100
    help
      Snipe CPI dividor value.

config LINEA40_PMW3610_SCROLL_TICK
    int "LINEA40_PMW3610's required ticks to produce a scroll report"
    default 20
    help
      Scroll tick value.

choice
    prompt "Select LINEA40_PMW3610's polling rate"
    default LINEA40_PMW3610_POLLING_RATE_250

config LINEA40_PMW3610_POLLING_RATE_250
    bool "250 Hz"

config LINEA40_PMW3610_POLLING_RATE_125
    bool "125 Hz"

config LINEA40_PMW3610_POLLING_RATE_125_SW
    bool "125 Hz with software implementation"

endchoice

config LINEA40_PMW3610_FORCE_AWAKE
    bool "LINEA40_PMW3610 forced awake mode"
    help
      This setting forces the sensor to always be in the RUN state.

config LINEA40_PMW3610_RUN_DOWNSHIFT_TIME_MS
    int "LINEA40_PMW3610's default RUN mode downshift time"
    default 128
    range 13 3264
    help
      Default RUN mode downshift down time in milliseconds.
      Time after which sensor goes from RUN to REST1 mode.

config LINEA40_PMW3610_REST1_SAMPLE_TIME_MS
    int "LINEA40_PMW3610's sample time in REST1 stage"
    default 40
    range 10 2550
    help
      Default REST1 mode sample period in millisecond

config LINEA40_PMW3610_REST1_DOWNSHIFT_TIME_MS
    int "LINEA40_PMW3610's default REST1 mode downshift time"
    default 9600
    help
      Default REST1 mode downshift down time in milliseconds.
      Time after which sensor goes from REST1 to REST2 mode.

config LINEA40_PMW3610_REST2_SAMPLE_TIME_MS
    int "LINEA40_PMW3610's sample time in REST2 stage"
    default 0
    range 0 2550
    help
      Default REST2 mode sample period in millisecond.
      Minimum value is 10.
      No optimal value provided by datasheet.

config LINEA40_PMW3610_REST2_DOWNSHIFT_TIME_MS
    int "LINEA40_PMW3610's default REST2 mode downshift time"
    default 0
    help
      Default REST2 mode downshift down time in milliseconds.
      Time after which sensor goes from REST2 to REST3 mode.
      No optimal value provided by datasheet.

config LINEA40_PMW3610_REST3_SAMPLE_TIME_MS
    int "LINEA40_PMW3610's sample time in REST3 stage"
    default 0
    range 0 2550
    help
      Default REST2 mode sample period in millisecond.
      Minimum value is 10.
      No optimal value provided by datasheet.

choice
    prompt "Select LINEA40_PMW3610 sensor orientation"
    default LINEA40_PMW3610_ORIENTATION_0

config LINEA40_PMW3610_ORIENTATION_0
    bool "LINEA40_PMW3610 not rotated"

config LINEA40_PMW3610_ORIENTATION_90
    bool "LINEA40_PMW3610 rotated 90 deg clockwise"

config LINEA40_PMW3610_ORIENTATION_180
    bool "LINEA40_PMW3610 rotated 180 deg clockwise"

config LINEA40_PMW3610_ORIENTATION_270
    bool "LINEA40_PMW3610 rotated 270 deg clockwise"

endchoice

config LINEA40_PMW3610_INVERT_X
  bool "Invert the X axis of LINEA40_PMW3610 sensor"

config LINEA40_PMW3610_INVERT_Y
  bool "Invert the Y axis of LINEA40_PMW3610 sensor"

config LINEA40_PMW3610_INVERT_SCROLL_X
  bool "Invert the X axis of the scroll"
  default LINEA40_PMW3610_INVERT_X

config LINEA40_PMW3610_INVERT_SCROLL_Y
  bool "Invert the Y axis of the scroll"
  default LINEA40_PMW3610_INVERT_Y

config LINEA40_PMW3610_AUTOMOUSE_TIMEOUT_MS
  int "Amount of milliseconds the mouse layer will be active after using the trackball"
  default 400

module = LINEA40_PMW3610
module-str = LINEA40_PMW3610
source "${ZEPHYR_BASE}/subsys/logging/Kconfig.template.log_config"

endif #LINEA40_PMW3610
```
